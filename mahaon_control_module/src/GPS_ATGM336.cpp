#include "GPS_ATGM336.h"																									//
#include "qdebug.h"

// СОХРАНЕНИЕ НАСТРОЕК В FLASH ПАМЯТЬ МОДУЛЯ:
void GPS_ATGM336::save(void) {																							//	Параметры:				отсутствуют.
    if (_objSerial->isOpen()) {																										//	Если модуль был инициализирован, то ...
        _printCommand("00");																								//	Команда $PCAS00*КОНТРОЛЬНАЯ_СУММА<CR><LF>
    }																														//
}
// УСТАНОВКА ЧАСТОТЫ ОБНОВЛЕНИЯ ДАННЫХ:																						//	Возвращаемое значение:	отсутствует.
void GPS_ATGM336::updaterate(uint8_t i) {
    if(_objSerial->isOpen()) {
        if (i<1 || i>10) return;																							//	Запрещаем выводить данные чаще 10 раз в секунду и не выводить их вообще.
        char str[8] = "02,\0\0\0\0"; uint16_t j = 1000 / i; uint8_t k = 3;													//	Определяем строку (str) для хранения команды, период (j) в миллисекундах и позицию (k) для подстановки символов в строку.
        if (j / 1000) { str[k] = j % 10000 / 1000+'0'; k++; } // Указываем старший   символ периода, если он есть.
        if (j / 100 ) { str[k] = j % 1000  / 100 +'0'; k++; } // Указываем следующий символ периода, если он есть.
        if (j / 10  ) { str[k] = j % 100   / 10  +'0'; k++; } // Указываем следующий символ периода, если он есть.
        if (j / 1   ) { str[k] = j % 10    / 1   +'0'; k++; } // Указываем следующий символ периода, если он есть.
        _printCommand(str);																									//	Команда $PCAS02,ПЕРИОД*КОНТРОЛЬНАЯ_СУММА<CR><LF> - установка периода от 100 до 1000 мс.
    }
}
// УСТАНОВКА СОСТАВА ПАКЕТА NMEA:																								//	Возвращаемое значение:	отсутствует.
void GPS_ATGM336::composition(uint8_t i1, uint8_t i2, uint8_t i3, uint8_t i4, uint8_t i5, uint8_t i6, uint8_t i7, uint8_t i8, uint8_t i9, uint8_t i10, uint8_t i11){	//	Параметры:	i1...i10 - флаги наличия идентификаторов GGA,GLL... в пакетах NMEA.
    if(_objSerial->isOpen()) {																										//	Если модуль был инициализирован, то ...
        char str[30] = "03,0,0,0,0,0,0,0,0,0,0,0,,0,0";																	//	Определяем строку (str) для хранения команды указания периодичности вывода идентификаторов в сообщениях NMEA.
        uint8_t i[11] = {i1,i2,i3,i4,i5,i6,i7,i8,i9,i10,i11};																//	Определяем массив полученных параметров данной функции.
        str[ 3] = memchr(i, NMEA_GGA, 11)?'1':'0';																	//	Определяем 3  символ строки (str) как '0' или '1'.
        str[ 5] = memchr(i, NMEA_GLL, 11)?'1':'0';																	//	Определяем 5  символ строки (str) как '0' или '1'.
        str[ 7] = memchr(i, NMEA_GSA, 11)?'1':'0';																	//	Определяем 7  символ строки (str) как '0' или '1'.
        str[ 9] = memchr(i, NMEA_GSV, 11)?'1':'0';																	//	Определяем 9  символ строки (str) как '0' или '1'.
        str[11] = memchr(i, NMEA_RMC, 11)?'1':'0';																	//	Определяем 11 символ строки (str) как '0' или '1'.
        str[13] = memchr(i, NMEA_VTG, 11)?'1':'0';																	//	Определяем 13 символ строки (str) как '0' или '1'.
        str[15] = memchr(i, NMEA_ZDA, 11)?'1':'0';																	//	Определяем 15 символ строки (str) как '0' или '1'.
        str[17] = memchr(i, NMEA_ANT, 11)?'1':'0';																	//	Определяем 17 символ строки (str) как '0' или '1'.
        str[19] = memchr(i, NMEA_DHV, 11)?'1':'0';																	//	Определяем 19 символ строки (str) как '0' или '1'.
        //	str[21]       =           //   LPS          '0'           															//	Определяем 21 символ строки (str) как '0' (идентификатор LPS не поддерживается модулем).
        str[23] = memchr(i, NMEA_TXT, 11)?'1':'0';																	//	Определяем 23 символ строки (str) как '0' или '1'.
        //	str[23]       =           //   ?																					//	                                          (идентификатор неизвестен).
        //	str[26]       =           //   UTC          '0'																		//	Определяем 26 символ строки (str) как '0' (идентификатор UTS не поддерживается модулем).
        str[28] = memchr(i, NMEA_GST, 11)?'1':'0';																	//	Определяем 28 символ строки (str) как '0' или '1'.
        _printCommand(str);																									//	Команда $PCAS03,GGA,GLL,GSA,GSV,RMC,VTG,ZDA,ANT,DHV,LPS,?,?,UTC,GST*КОНТРОЛЬНАЯ_СУММА<CR><LF> - установка периодичности вывода идентификаторов в сообщениях NMEA.
    }																														//
}
//		ВЫБОР ИСПОЛЬЗУЕМЫХ НАВИГАЦИОННЫХ СИСТЕМ:																					//	Возвращаемое значение:	отсутствует.
void GPS_ATGM336::system(uint8_t i1, uint8_t i2, uint8_t i3) {															//	Параметры:				i1...i3 - флаги использования навигационных систем (GPS_GL - Glonass / GPS_BD - Beidu / GPS_GP - GPS).
    if (_objSerial->isOpen()){																										//	Если модуль был инициализирован, то ...
        if( i1>7 || i2>7 || i3>7 ) { return; }																					//
        char str[5] = "04,0"; str[3] = (uint8_t)( ( (1<<i1) | (1<<i2) | (1<<i3) ) & 0x0F )+'0';								//	Определяем строку (str) для хранения команды выбора навигационных систем.
        _printCommand(str);																									//	Команда $PCAS04,БАЙТ_ФЛАГОВ*КОНТРОЛЬНАЯ_СУММА<CR><LF> - выбор навигационных систем.
    }																														//
}
//		ВЫБОР ВЕРСИИ NMEA:																											//	Возвращаемое значение:	отсутствует.
void GPS_ATGM336::version(float i) {																						//	Параметр:				i - версия NMEA.
    if(_objSerial->isOpen()){																										//	Если модуль был инициализирован, то ...
        if(i==2.2f){ i=9; }else if(i==4.0f){ i=5; }else if(i==4.1f){ i=2; }else{return;}									//
        char str[5] = "05,0"; str[3] = i+'0';																				//	Определяем строку (str) для хранения команды выбора версии NMEA.
        _printCommand(str);																									//	Команда $PCAS05,ВЕРСИЯ*КОНТРОЛЬНАЯ_СУММА<CR><LF> - выбор версии NMEA.
    }																														//
}
//		ПЕРЕЗАГРУЗКА:																												//	Возвращаемое значение:	отсутствует.
void GPS_ATGM336::reset(uint8_t i) {																						//	Параметр:				i - тип старта после перезагрузки (GPS_HOT_START / GPS_WARM_START / GPS_COLD_START / GPS_FACTORY_SET).
    if (_objSerial->isOpen()) {																										//	Если модуль был инициализирован, то ...
        if( i>3 ){ return; }																								//
        char str[5] = "10,0"; str[3] = i+'0';																				//	Определяем строку (str) для хранения команды выбора версии NMEA.
        _printCommand(str);																									//	Команда $PCAS05,ТИП_СТАРТА*КОНТРОЛЬНАЯ_СУММА<CR><LF> - выбор версии NMEA.
    }																														//
}
//		ТИП МОДЕЛИ:																													//	Возвращаемое значение:	отсутствует.
void GPS_ATGM336::model(uint8_t i) {																						//	Параметр:				i - тип модели (GPS_PORTABLE / GPS_STATIC / GPS_WALKING / GPS_VEHICLE / GPS_VOYAGE / GPS_AVIATION_1G / GPS_AVIATION_2G / GPS_AVIATION_4G).
    if (_objSerial->isOpen()) {																										//	Если модуль был инициализирован, то ...
        if( i>7 ){ return; }																								//
        char str[5] = "11,0"; str[3] = i+'0';																				//	Определяем строку (str) для хранения команды выбора динамической модели навигационной платформы.
        _printCommand(str);																									//	Команда $PCAS05,МОДЕЛЬ*КОНТРОЛЬНАЯ_СУММА<CR><LF> - выбор версии NMEA.
    }																														//
}

void GPS_ATGM336::baudrate(uint32_t bps) { //	Объявляем  функцию установки скорости (Параметр:  скорость 4800/9600/19200/38400/57600/115200, если параметр отсутствует то будет установлена скорость на которую настроен модуль).
    if (_objSerial->isOpen()) {
        if (bps) {
            if (bps == 4800) {
                _printCommand("01,0");
            } else if(bps == 9600) {
                _printCommand("01,1");
            } else if(bps == 19200) {
                _printCommand("01,2");
            } else if(bps == 38400) {
                _printCommand("01,3");
            } else if(bps == 57600) {
                _printCommand("01,4");
            }
            else if(bps ==115200) {
                _printCommand("01,5");
            } else {
                return;
            }
        }
    }
}

// ОТПРАВКА КОМАНДЫ ПО UART С ДОБАВЛЕНИЕМ ПРЕФИКСА КОМАНДЫ '$PCAS' И КОНТРОЛЬНОЙ СУММЫ:										//	Возвращаемое значение:	отсутствует.
void GPS_ATGM336::_printCommand(const char* str) {																		//	Параметры:				строка состоящая из номера команды и её параметров.
    uint8_t _checkSum = 1;																									//	Определяем переменную для подсчёта контрольной суммы. Значение 1 соответствует строке "PCAS".
    char _strEnd[6] = "*--\r\n";																							//	Определяем строку содержащую символы контрольной суммы.
    for (uint8_t i = 0; i < 255; i++) { if(str[i]==0){break;}else{_checkSum ^= str[i];} }											//	Вычисляем контрольную сумму.
    _strEnd[1]=(_checkSum/16)+'0'; if(_strEnd[1]>'9'){_strEnd[1]+=7;}														//	Определяем 1 символ контрольной суммы.
    _strEnd[2]=(_checkSum%16)+'0'; if(_strEnd[2]>'9'){_strEnd[2]+=7;}														//	Определяем 2 символ контрольной суммы.
    _SerialPrint("$PCAS");																									//	Выводим префикс команды.
    _SerialPrint(str);																										//	Выводим номер команды и её параметры.
    _SerialPrint(_strEnd);																									//	Выводим строку содержащую контрольную сумму.
}

void GPS_ATGM336::_SerialPrint(const char* i) {
    if (_objSerial->isOpen()) {
        _objSerial->write(i);
        _objSerial->flush();
        // qDebug() << i;
    }
}
